## firmware/stanag-s3-simulator/main/Kconfig
```kconfig
menuconfig STATUS_LED_ENABLE
    bool "Enable status LED"
    default y
    help
        Drive an onboard status LED to indicate system state:
        WiFi association, SRT connection, and error conditions.

if STATUS_LED_ENABLE

config STATUS_LED_GPIO
    int "Status LED GPIO"
    default 47
    range 0 48
    help
        GPIO connected to the onboard LED.
        Confirmed on this board: 47.
        Other common values: 48 (RGB LED pin on some S3 DevKit clones), 21, 2.
        If the LED stays dark, try another value (and set ACTIVE-LOW if the
        LED is wired to VCC instead of the GPIO).

config STATUS_LED_ACTIVE_LOW
    bool "Status LED is active-low"
    default n
    help
        Set when the LED turns on at logic 0 (wired to VCC).
        Most boards drive the LED from GPIO (active-high).

config STATUS_LED_SCAN
    bool "Run LED pin scan at boot"
    default n
    help
        Diagnostic: walk every safe GPIO and blink each one so you can
        identify which pin the onboard LED is on. Runs once at boot
        (~25s) then exits. Watch the serial log for the GPIO numbers.

endif
```

## firmware/stanag-s3-simulator/main/Kconfig.projbuild
```kconfig
#
# STANAG S3 Simulator - Project Configuration
#

menu "STANAG S3 Simulator Configuration"

config WIFI_SSID
    string "WiFi SSID"
    default ""
    help
        SSID of the WiFi network to connect to.
        Leave empty to run in ESP-NOW only mode (no AP connection).

config WIFI_PASSWORD
    string "WiFi Password"
    default ""
    help
        Password for the WiFi network.
        Required if SSID is set.

endmenu
```
