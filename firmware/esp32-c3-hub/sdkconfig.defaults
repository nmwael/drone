## firmware/esp32-c3-hub/sdkconfig.defaults
```kconfig
# ESP32-C3 Sensor Hub - sdkconfig.defaults
# GPS + IMU + Mag + Baro + Temp/Humidity + EKF

# Target
CONFIG_IDF_TARGET="esp32c3"
CONFIG_IDF_TARGET_ESP32C3=y

# Partition table
CONFIG_PARTITION_TABLE_CUSTOM=y
CONFIG_PARTITION_TABLE_CUSTOM_FILENAME="partitions.csv"
CONFIG_PARTITION_TABLE_OFFSET=0x8000

# Flash
CONFIG_FLASH_SIZE=4MB
CONFIG_FLASH_FREQ_80M=y

# CPU Frequency
CONFIG_ESP_DEFAULT_CPU_FREQ_MHZ=160

# FreeRTOS
CONFIG_FREERTOS_HZ=1000
CONFIG_FREERTOS_USE_TRACE_FACILITY=y

# WiFi - ESP-NOW for S3 comms, AP for ESP8266 relay
CONFIG_ESP32_WIFI_ENABLE_WPA3_SAE=y
CONFIG_ESP_WIFI_ESPNOW_MAX_ENCRYPT_NUM=6
CONFIG_ESP_WIFI_ESPNOW_ENABLE_LONG_RANGE=y

# UART - multiple for RP2040s + GPS
CONFIG_UART_ISR_IN_IRAM=y

# I2C - multiple sensors
CONFIG_I2C_ISR_IRAM_SAFE=y

# ESP-NOW
CONFIG_ESP_WIFI_ESPNOW=y

# Logging
CONFIG_LOG_DEFAULT_LEVEL_INFO=y
CONFIG_LOG_MAXIMUM_LEVEL_VERBOSE=y

# Optimization
CONFIG_COMPILER_OPTIMIZATION_SIZE=y
CONFIG_COMPILER_OPTIMIZATION_ASSERTIONS_DISABLE=y
```

## firmware/esp32-s3-vision/sdkconfig.defaults
```kconfig
# ESP32-S3 Vision - sdkconfig.defaults
# STANAG 4609 Video + Vision Processing

# Target
CONFIG_IDF_TARGET="esp32s3"
CONFIG_IDF_TARGET_ESP32S3=y

# Partition table - need space for PSRAM, video buffers
CONFIG_PARTITION_TABLE_CUSTOM=y
CONFIG_PARTITION_TABLE_CUSTOM_FILENAME="partitions.csv"
CONFIG_PARTITION_TABLE_OFFSET=0x8000

# PSRAM - REQUIRED for H.264 encoding
CONFIG_SPIRAM=y
CONFIG_SPIRAM_USE_MALLOC=y
CONFIG_SPIRAM_MALLOC_ALWAYSINTERNAL=0
CONFIG_SPIRAM_TRY_ALLOCATE_WIFI_LWIP=y
CONFIG_SPIRAM_ALLOW_BSS_SEG_EXTERNAL_MEMORY=y
CONFIG_SPIRAM_CACHE_WORKAROUND=y

# Flash
CONFIG_FLASH_SIZE=16MB
CONFIG_FLASH_FREQ_80M=y

# CPU Frequency
CONFIG_ESP_DEFAULT_CPU_FREQ_MHZ=240

# FreeRTOS
CONFIG_FREERTOS_HZ=1000
CONFIG_FREERTOS_USE_TRACE_FACILITY=y
CONFIG_FREERTOS_GENERATE_RUN_TIME_STATS=y

# WiFi - ESP-NOW for low latency
CONFIG_ESP32_WIFI_ENABLE_WPA3_SAE=y
CONFIG_ESP_WIFI_ESPNOW_MAX_ENCRYPT_NUM=6
CONFIG_ESP_WIFI_ESPNOW_ENABLE_LONG_RANGE=y

# Camera
CONFIG_CAMERA_ENABLE=y
CONFIG_CAMERA_DVP_MAX_FREQ=40000000
CONFIG_ESP_VIDEO_ENABLE=y

# Video Encoder (H.264 HW)
CONFIG_VIDEO_ENCODER_H264=y
CONFIG_VIDEO_ENCODER_H264_HW_ACCEL=y

# ESP-DL for TFLite
CONFIG_ESP_DL_ENABLE=y
CONFIG_TFLITE_MICRO_ENABLE=y

# UART for C3 communication
CONFIG_UART_ISR_IN_IRAM=y

# Logging
CONFIG_LOG_DEFAULT_LEVEL_INFO=y
CONFIG_LOG_MAXIMUM_LEVEL_VERBOSE=y

# Optimization
CONFIG_COMPILER_OPTIMIZATION_SIZE=y
CONFIG_COMPILER_OPTIMIZATION_ASSERTIONS_DISABLE=y
```
